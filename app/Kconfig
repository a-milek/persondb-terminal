## app/sample.yaml
```yaml
sample:
  description: A made-up airline's flight database on a full-screen terminal
  name: flight-terminal
common:
  tags: [storage, cbor]
tests:
  app.flight_terminal.tui:
    build_only: true
```
